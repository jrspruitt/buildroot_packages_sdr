## dump1090/Config.in
```kconfig
config BR2_PACKAGE_DUMP1090
	bool 'dump1090'
	depends on BR2_PACKAGE_LIBRTLSDR
	help
	  Mode S decoder designed for RTLSDR devices.

	  https://github.com/antirez/dump1090
```

## kalibrate-rtl/Config.in
```kconfig
config BR2_PACKAGE_KALIBRATE_RTL
	bool "kalibrate-rtl"
	select BR2_PACKAGE_FFTW
	select BR2_PACKAGE_LIBRTLSDR
	depends on BR2_TOOLCHAIN_HAS_THREADS
	help
	  Calibration program for RTL2832U SDR dongles.

	  https://github.com/steve-m/kalibrate-rtl
```
